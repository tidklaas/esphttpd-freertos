## sdkconfig.defaults
```kconfig
CONFIG_SYSTEM_EVENT_TASK_STACK_SIZE=4096
CONFIG_TIMER_TASK_STACK_DEPTH=3072

#
# esphttpd
#
CONFIG_ESPHTTPD_ENABLED=y
CONFIG_ESPHTTPD_USE_ESPFS=y

#
# espfs
#
CONFIG_ESPFS_IMAGEROOTDIR="html"

#
# WiFi Manager
#
CONFIG_WMNGR_ENABLED=y
CONFIG_WMNGR_TASK=y
```
